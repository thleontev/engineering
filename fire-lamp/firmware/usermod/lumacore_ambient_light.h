#pragma once

// AI: below section was generated by an AI
// Fire Lamp's ambient light measurement interface, separate from PIR/night-light.
// Both sensor types are deliberately explicit; there is no silent failover.
// Vishay VEML7700: https://www.vishay.com/docs/84286/veml7700.pdf
// Vishay application note: https://www.vishay.com/docs/84323/designingveml7700.pdf
#include <stdint.h>
#include <Wire.h>
#include "lumacore_veml7700_math.h"

namespace lumacore {

struct AmbientLightReading {
  float lux = 0.0f;
  uint16_t als = 0;
  uint16_t white = 0;
  uint32_t sampledAt = 0;
  bool valid = false;
  bool saturated = false;
};

class AmbientLightSensor {
public:
  virtual ~AmbientLightSensor() {}
  virtual bool begin(TwoWire& wire, uint32_t now) = 0;
  virtual void poll(uint32_t now) = 0;
  virtual const char* name() const = 0;
  virtual const char* status() const = 0;
  virtual bool present() const = 0;
  virtual const AmbientLightReading& reading() const = 0;
  virtual uint32_t errors() const = 0;
  virtual uint16_t integrationMs() const = 0;
  virtual const char* gain() const = 0;
  virtual float resolution() const = 0;

  bool fresh(uint32_t now, uint32_t maxAgeMs) const {
    const AmbientLightReading& r = reading();
    return present() && r.valid && (uint32_t)(now - r.sampledAt) <= maxAgeMs;
  }
};

class Bh1750AmbientLightSensor final : public AmbientLightSensor {
  TwoWire* bus = nullptr;
  uint8_t addr = 0x23;
  AmbientLightReading data;
  bool found = false;
  uint32_t lastAttempt = 0;
  uint32_t lastRead = 0;
  uint32_t faults = 0;
  const char* state = "not-started";
  static constexpr uint32_t interval = 2000;

  bool command(uint8_t c) {
    bus->beginTransmission(addr);
    bus->write(c);
    if (bus->endTransmission() == 0) return true;
    ++faults;
    return false;
  }

  bool configure(uint32_t now) {
    data.valid = false;
    found = false;
    if (!command(0x01) || !command(0x07) ||
        !command(0x40 | (254 >> 5)) ||
        !command(0x60 | (254 & 0x1f)) ||
        !command(0x11)) {
      state = "i2c-error";
      return false;
    }
    lastRead = now;
    found = true;
    state = "warming";
    return true;
  }

public:
  explicit Bh1750AmbientLightSensor(uint8_t address = 0x23) : addr(address) {}
  bool begin(TwoWire& wire, uint32_t now) override {
    bus = &wire;
    lastAttempt = now;
    return configure(now);
  }
  void poll(uint32_t now) override {
    if (!bus || (uint32_t)(now - lastRead) < interval) return;
    if (!found) {
      if ((uint32_t)(now - lastAttempt) < interval) return;
      lastAttempt = now;
      configure(now);
      return;
    }
    lastRead = now;
    if (bus->requestFrom(addr, static_cast<uint8_t>(2)) != 2) {
      ++faults;
      found = false;
      data.valid = false;
      state = "i2c-error";
      lastAttempt = now;
      return;
    }
    data.als = (static_cast<uint16_t>(bus->read()) << 8) | static_cast<uint8_t>(bus->read());
    data.white = 0;
    data.lux = (static_cast<float>(data.als) / 1.2f) * (69.0f / 254.0f) / 2.0f;
    data.sampledAt = now;
    data.saturated = data.als == 0xFFFF;
    data.valid = !data.saturated;
    state = data.saturated ? "saturated" : "ready";
  }
  const char* name() const override { return "BH1750"; }
  const char* status() const override { return state; }
  bool present() const override { return found; }
  const AmbientLightReading& reading() const override { return data; }
  uint32_t errors() const override { return faults; }
  uint16_t integrationMs() const override { return 500; }
  const char* gain() const override { return "MTreg254 H-Res2"; }
  float resolution() const override { return (1.0f / 1.2f) * (69.0f / 254.0f) / 2.0f; }
};

class Veml7700AmbientLightSensor final : public AmbientLightSensor {
  TwoWire* bus = nullptr;
  AmbientLightReading data;
  uint8_t range = lumacore_veml7700::startProfile;
  bool found = false;
  uint16_t deviceId = 0;
  uint32_t faults = 0;
  uint32_t configuredAt = 0;
  uint32_t lastRead = 0;
  uint32_t lastAttempt = 0;
  const char* state = "not-started";
  static constexpr uint8_t address = 0x10;
  static constexpr uint32_t interval = 2000;

  bool readRegister(uint8_t reg, uint16_t& value) {
    bus->beginTransmission(address);
    bus->write(reg);
    if (bus->endTransmission(false) != 0) {
      ++faults;
      return false;
    }
    if (bus->requestFrom(address, static_cast<uint8_t>(2)) != 2) {
      ++faults;
      return false;
    }
    const uint8_t lo = static_cast<uint8_t>(bus->read());
    const uint8_t hi = static_cast<uint8_t>(bus->read());
    value = (static_cast<uint16_t>(hi) << 8) | lo;
    return true;
  }

  // Reject the previous sample when changing range, including during I2C faults.
  bool configure(uint8_t index, uint32_t now) {
    const uint16_t command = lumacore_veml7700::configWord(index);
    bus->beginTransmission(address);
    bus->write(static_cast<uint8_t>(0x00));
    bus->write(static_cast<uint8_t>(command & 0xff));
    bus->write(static_cast<uint8_t>(command >> 8));
    if (bus->endTransmission() != 0) {
      ++faults;
      return false;
    }
    uint16_t readback = 0;
    if (!readRegister(0x00, readback) || readback != command) {
      if (readback != command) ++faults;
      return false;
    }
    range = index;
    configuredAt = now;
    lastRead = now;
    data.valid = false;
    data.saturated = false;
    state = "settling";
    return true;
  }

  bool initialize(uint32_t now) {
    data.valid = false;
    found = false;
    deviceId = 0;
    if (!readRegister(0x07, deviceId)) {
      state = "missing";
      return false;
    }
    if ((deviceId & 0xff) != 0x81) {
      ++faults;
      state = "wrong-id";
      return false;
    }
    if (!configure(lumacore_veml7700::startProfile, now)) {
      state = "i2c-error";
      return false;
    }
    found = true;
    return true;
  }

public:
  bool begin(TwoWire& wire, uint32_t now) override {
    bus = &wire;
    lastAttempt = now;
    return initialize(now);
  }

  void poll(uint32_t now) override {
    if (!bus) return;
    if (!found) {
      if ((uint32_t)(now - lastAttempt) < interval) return;
      lastAttempt = now;
      initialize(now);
      return;
    }
    if ((uint32_t)(now - configuredAt) < lumacore_veml7700::settlingMs(range)) return;
    if ((uint32_t)(now - lastRead) < interval) return;
    lastRead = now;
    uint16_t als = 0;
    uint16_t white = 0;
    if (!readRegister(0x04, als) || !readRegister(0x05, white)) {
      found = false;
      data.valid = false;
      state = "i2c-error";
      lastAttempt = now;
      return;
    }
    data.als = als;
    data.white = white;
    const uint8_t next = lumacore_veml7700::nextProfile(range, als);
    if (next != range) {
      if (!configure(next, now)) {
        found = false;
        data.valid = false;
        state = "i2c-error";
        lastAttempt = now;
      }
      return;
    }
    data.saturated = als >= 60000;
    data.valid = !data.saturated;
    if (data.valid) {
      data.lux = lumacore_veml7700::nominalLux(range, als);
      data.sampledAt = now;
    }
    state = data.saturated ? "saturated" : "ready";
  }

  const char* name() const override { return "VEML7700"; }
  const char* status() const override { return state; }
  bool present() const override { return found; }
  const AmbientLightReading& reading() const override { return data; }
  uint32_t errors() const override { return faults; }
  uint16_t integrationMs() const override { return lumacore_veml7700::profiles[range].integrationMs; }
  const char* gain() const override { return lumacore_veml7700::profiles[range].gainLabel; }
  float resolution() const override { return lumacore_veml7700::profiles[range].luxPerCount; }
  uint16_t id() const { return deviceId; }
};

} // namespace lumacore
// AI: end
